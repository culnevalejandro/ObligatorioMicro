#include <Adafruit_GFX.h>
#include <Adafruit_SSD1306.h>
#include <SPI.h>

// Definiciones para la pantalla OLED SPI
#define SCREEN_WIDTH 128     // Ancho de la pantalla OLED, en píxeles
#define SCREEN_HEIGHT 64     // Altura de la pantalla OLED, en píxeles
#define OLED_RST_PIN 9       // Pin de reset de la pantalla (ajustar según tu conexión)
#define OLED_DC_PIN 8        // Pin de datos/comando (ajustar según tu conexión)
#define OLED_CS_PIN 10       // Pin de chip select (ajustar según tu conexión)

// Pins para el botón
#define BUTTON_PIN 2         // Pin del botón (ajustar según tu conexión)
#define DEBOUNCE_DELAY 50    // Retardo para evitar el rebote del botón

// Instancia de la pantalla OLED utilizando SPI
Adafruit_SSD1306 display(SCREEN_WIDTH, SCREEN_HEIGHT, &SPI, OLED_DC_PIN, OLED_RST_PIN, OLED_CS_PIN);

// OLED Animation: calculator
// Código auto-generado por https://wokwi.com/animator, gráficos por icons8.com

#define FRAME_DELAY (42)
#define FRAME_WIDTH (32)
#define FRAME_HEIGHT (32)
#define FRAME_COUNT (sizeof(frames) / sizeof(frames[0]))
const byte PROGMEM frames[][128] = {
  {0,0,0,0,0,0,0,0,0,0,0,0,7,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0,0},
  {0,0,0,0,0,0,0,0,0,0,0,0,7,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0,0},
  {0,0,0,0,0,0,0,0,0,0,0,0,7,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0,0},
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  {0,0,0,0,0,0,0,0,0,0,0,0,7,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0,0}
};

// Definiciones para la segunda animación
const byte PROGMEM frames2[][128] = {
  {0,0,0,0,15,255,240,0,15,255,248,0,12,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0,0},
  {0,0,0,0,15,255,240,0,15,255,248,0,12,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0,0},
  {0,0,0,0,15,255,240,0,15,255,248,0,12,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0,0},
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  {0,0,0,0,15,255,240,0,15,255,248,0,12,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0,0}
};


int frame = 0;


// Posición actual del cuadrado (0: izquierda, 1: derecha)
int squarePosition = 0;
// Estado del botón
int buttonState;
// Estado anterior del botón
int lastButtonState = HIGH;
// Último momento en que se pulsó el botón
unsigned long lastDebounceTime = 0;



void printCenteredText(String text) {

  display.setTextColor(SSD1306_WHITE);
  display.setTextSize(1);
  display.setCursor((SCREEN_WIDTH - text.length() * 6) / 2,50);
  display.print(text);
}


void setup() {
  // Inicializa la pantalla OLED
  if (!display.begin(SSD1306_SWITCHCAPVCC)) {
    Serial.println(F("SSD1306 allocation failed"));
    for (;;); // Detener si falla la inicialización
  }
  display.clearDisplay();

  // Configura el pin del botón como entrada
  pinMode(BUTTON_PIN, INPUT_PULLUP);
}




void loop() {
  // Lee el estado del botón y realiza el debounce
  int reading = digitalRead(BUTTON_PIN);
  if (reading != lastButtonState) {
    lastDebounceTime = millis();
  }
  if (millis() - lastDebounceTime > DEBOUNCE_DELAY) {
    if (reading != buttonState) {
      buttonState = reading;
      // Si el estado del botón ha cambiado
      if (buttonState == LOW) {
        // Se ha pulsado el botón, cambia la posición del cuadrado
        squarePosition = 1 - squarePosition; // Cambia entre 0 y 1
        frame = 0; // Reinicia el frame cuando cambia de posición
      }
    }
  }
  lastButtonState = reading;

  // Borra la pantalla
  display.clearDisplay();


  // Dibuja el frame de la primera animación en la posición izquierda
  if (squarePosition == 0) {
    // Si el botón está presionado y el cuadrado está a la izquierda, muestra la primera animación
    display.drawBitmap(20, 8, frames[frame], FRAME_WIDTH, FRAME_HEIGHT, 1);
    display.drawBitmap(76, 8, frames2[0], FRAME_WIDTH, FRAME_HEIGHT, 1);

    display.drawRect(16, 4, 40, 40, 1);

    printCenteredText("Calculadora");


  } else {
    // De lo contrario, muestra el primer frame de la primera animación (estática)
    display.drawBitmap(20, 8, frames[0], FRAME_WIDTH, FRAME_HEIGHT, 1);
    display.drawBitmap(76, 8, frames2[frame], FRAME_WIDTH, FRAME_HEIGHT, 1);

    display.drawRect(72, 4, 40, 40, 1);

    printCenteredText("ROT13");


  }


  // Actualiza la pantalla
  display.display();

  // Actualiza el frame de la animación
  frame = (frame + 1) % min(FRAME_COUNT, max(sizeof(frames), sizeof(frames2)) / sizeof(frames[0]));

  // Retardo entre frames
  delay(FRAME_DELAY);
}
